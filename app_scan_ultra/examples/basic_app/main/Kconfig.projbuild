## examples/iobewi_driver_a02yyuw/basic_app/main/Kconfig.projbuild
```kconfig
menu "A02YYUW Basic App"

config A02_BASIC_EN_GPIO
    int "Enable GPIO"
    default 14
    help
        GPIO used to enable power for the A02YYUW sensor.

config A02_BASIC_UART_RX_GPIO
    int "UART RX GPIO"
    default 18
    help
        GPIO connected to the A02YYUW TX pin (ESP RX).

config A02_BASIC_MODE_GPIO
    int "Mode GPIO"
    default 5
    help
        GPIO connected to the A02YYUW RX pin used to select output mode.

endmenu
```

## examples/iobewi_driver_max98357a/hls_stream_app/main/Kconfig.projbuild
```kconfig
menu "HLS Stream Player Configuration"

    menu "WiFi Configuration"
        config WIFI_SSID
            string "WiFi SSID"
            default "myssid"
            help
                SSID (network name) to connect to.

        config WIFI_PASSWORD
            string "WiFi Password"
            default "mypassword"
            help
                WiFi password (WPA or WPA2).

        config WIFI_MAXIMUM_RETRY
            int "Maximum retry"
            default 5
            help
                Set the Maximum retry to avoid station reconnecting to the AP unlimited when the AP is really inexistent.
    endmenu

    menu "Stream Configuration"
        config HLS_STREAM_URL
            string "HLS/M3U8 Stream URL"
            default "http://stream.example.com/playlist.m3u8"
            help
                URL of the HLS/M3U8 stream to play.
                Example: http://stream.live.vc.bbcmedia.co.uk/bbc_world_service

        config STREAM_BUFFER_SIZE
            int "Stream Buffer Size (KB)"
            default 16
            range 8 64
            help
                Size of the ring buffer for streaming data in KB.
                Larger buffer = more latency but more resilient to network jitter.
                Note: ESP32-S3 without PSRAM should use 16KB or less.
    endmenu

    menu "I2S Configuration"
        config I2S_BCLK_PIN
            int "I2S BCLK GPIO"
            default 4
            help
                GPIO pin for I2S bit clock (BCLK).

        config I2S_WS_PIN
            int "I2S WS GPIO"
            default 5
            help
                GPIO pin for I2S word select (WS/LRCLK).

        config I2S_DOUT_PIN
            int "I2S DOUT GPIO"
            default 18
            help
                GPIO pin for I2S data out (DOUT).

        config I2S_SD_MODE_PIN
            int "SD_MODE GPIO"
            default -1
            help
                GPIO pin for MAX98357A SD_MODE (shutdown control).
                Set to -1 to disable.

        config AUDIO_SAMPLE_RATE
            int "Audio Sample Rate"
            default 44100
            help
                Sample rate in Hz (typically 44100 or 48000).
    endmenu

endmenu
```

## examples/iobewi_libs_vl53l0x_provider/basic_app/sdkconfig.defaults
```kconfig
# ESP32-S3 target
CONFIG_IDF_TARGET="esp32s3"

# FreeRTOS
CONFIG_FREERTOS_HZ=1000

# Log level
CONFIG_LOG_DEFAULT_LEVEL_INFO=y

# Stack size
CONFIG_ESP_MAIN_TASK_STACK_SIZE=8192
```

## examples/iobewi_mw_uros_transport_usb/basic_app/sdkconfig.defaults
```kconfig
# USB-CDC Transport Middleware Basic App - Default Configuration

# ESP-IDF system
CONFIG_ESP_SYSTEM_EVENT_TASK_STACK_SIZE=4096

# Log level
CONFIG_LOG_DEFAULT_LEVEL_INFO=y

# FreeRTOS
CONFIG_FREERTOS_HZ=1000

# micro-ROS transport
CONFIG_MICRO_ROS_TRANSPORT_USB_CDC=y

# TinyUSB configuration
CONFIG_TINYUSB_CDC_ENABLED=y
CONFIG_TINYUSB_CDC_COUNT=2
CONFIG_TINYUSB_CDC_RX_BUFSIZE=512
CONFIG_TINYUSB_CDC_TX_BUFSIZE=512

# USB device descriptor
CONFIG_TINYUSB_DESC_USE_ESPRESSIF_VID=y
```

## lib_a02_provider/examples/basic_app/main/Kconfig.projbuild
```kconfig
menu "A02 Provider Example Configuration"

    config A02_PROVIDER_UART_RX_GPIO
        int "UART RX GPIO"
        default 18
        help
            GPIO connected to A02YYUW TX pin (UART RX)

    config A02_PROVIDER_MODE_GPIO
        int "Mode GPIO"
        default 5
        help
            GPIO connected to A02YYUW RX pin (mode control)

    config A02_PROVIDER_EN_GPIO_0
        int "EN GPIO Sensor 0"
        default 14
        help
            GPIO for STMPS2141STR EN (sensor 0)

    config A02_PROVIDER_EN_GPIO_1
        int "EN GPIO Sensor 1"
        default 10
        help
            GPIO for STMPS2141STR EN (sensor 1)

    config A02_PROVIDER_EN_GPIO_2
        int "EN GPIO Sensor 2"
        default 7
        help
            GPIO for STMPS2141STR EN (sensor 2)

    config A02_PROVIDER_EN_GPIO_3
        int "EN GPIO Sensor 3"
        default 4
        help
            GPIO for STMPS2141STR EN (sensor 3)

endmenu
```

## mw_uros_core/examples/basic_app/sdkconfig.defaults
```kconfig
# micro-ROS Core Basic App - Default Configuration

# ESP-IDF system
CONFIG_ESP_SYSTEM_EVENT_TASK_STACK_SIZE=4096

# Log level
CONFIG_LOG_DEFAULT_LEVEL_INFO=y

# FreeRTOS
CONFIG_FREERTOS_HZ=1000

# micro-ROS transport (choose one)
# CONFIG_MICRO_ROS_TRANSPORT_UART=y
# CONFIG_MICRO_ROS_TRANSPORT_UDP=y
CONFIG_MICRO_ROS_TRANSPORT_USB_CDC=y

# WiFi (if using UDP transport)
# CONFIG_ESP_WIFI_STATIC_RX_BUFFER_NUM=16
# CONFIG_ESP_WIFI_DYNAMIC_RX_BUFFER_NUM=32
# CONFIG_ESP_WIFI_DYNAMIC_TX_BUFFER_NUM=32

# Networking (if using UDP transport)
# CONFIG_LWIP_MAX_SOCKETS=16
# CONFIG_LWIP_SO_RCVBUF=y
```
