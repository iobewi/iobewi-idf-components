## app_scan_ultra/examples/basic_app/main/Kconfig.projbuild
```kconfig
menu "Ultrasonic Scan App Configuration"

    config APP_SCAN_UART_RX_GPIO
        int "UART RX GPIO"
        default 18
        help
            GPIO connected to A02YYUW TX pin (UART RX)

    config APP_SCAN_MODE_GPIO
        int "Mode GPIO"
        default 5
        help
            GPIO connected to A02YYUW RX pin (mode control)

    config APP_SCAN_EN_GPIO_0
        int "EN GPIO Sensor 0 (0°)"
        default 14
        help
            GPIO for STMPS2141STR EN (sensor 0, front)

    config APP_SCAN_EN_GPIO_1
        int "EN GPIO Sensor 1 (90°)"
        default 10
        help
            GPIO for STMPS2141STR EN (sensor 1, right)

    config APP_SCAN_EN_GPIO_2
        int "EN GPIO Sensor 2 (180°)"
        default 7
        help
            GPIO for STMPS2141STR EN (sensor 2, back)

    config APP_SCAN_EN_GPIO_3
        int "EN GPIO Sensor 3 (270°)"
        default 4
        help
            GPIO for STMPS2141STR EN (sensor 3, left)

    config APP_SCAN_STATUS_LED_GPIO
        int "Status LED GPIO"
        default 38
        help
            GPIO for status LED (micro-ROS status)

endmenu
```

## components/iobewi_apps_hls_player/Kconfig
```kconfig
menu "HLS Player Configuration"

    config APP_HLS_PLAYER_RING_BUFFER_SIZE
        int "Ring buffer size (KB)"
        default 128 if SPIRAM
        default 64 if !SPIRAM
        range 32 256
        help
            Size of the ring buffer for streaming data in KB.

            Recommended values:
            - With PSRAM: 128-256 KB (better resilience to jitter)
            - Without PSRAM: 64-96 KB (balance RAM/stability)

            Larger buffer = more latency but more resilient to network jitter.

    config APP_HLS_PLAYER_REM_BUFFER_SIZE
        int "Remainder buffer size (KB) - P1.3 RAM optimization"
        default 8
        range 4 16
        help
            [RAM OPT P1.3] Small buffer to keep unconsumed bytes between decode cycles.

            This replaces the large encoded_buffer (144 KB → 8 KB = -136 KB gain).

            Recommended values:
            - 4 KB: Minimal, may increase decode errors if TS packets are large
            - 8 KB: Recommended (sufficient for AAC/TS, tested)
            - 16 KB: Conservative (if decode errors occur)

            Larger = more resilient to large TS packets, but more RAM.
            Typical remainder size observed: < 4 KB.

    config APP_HLS_PLAYER_DEC_BUFFER_SIZE
        int "Decoded buffer size (KB)"
        default 16
        range 8 32
        help
            Size of the output PCM buffer in KB.

            Default 16 KB is sufficient for most cases (48kHz stereo).
            Only increase if you experience audio glitches with high sample rates.

    config APP_HLS_PLAYER_DROP_OLD_ON_FULL
        bool "Drop old data when ring buffer full (recommended)"
        default y
        help
            When enabled, drops oldest chunk from ring buffer to make room for new data.
            This improves live-ness by keeping the stream fresh.

            When disabled, drops new data (classic behavior) which can cause temporal drift.

            Recommended: ENABLED for live streams, DISABLED for VOD.

endmenu
```

## components/iobewi_apps_hls_player/Kconfig.projbuild
```kconfig
menu "HLS Player Configuration"

    choice APP_HLS_LOG_MODE
        prompt "HLS log mode"
        default APP_HLS_LOG_MODE_PROD
        help
            Controls runtime observability verbosity for HLS player.

            PROD: silent run (errors + critical warnings only)
            RUN: PROD + sparse summaries
            DIAG_LIGHT: RUN + throttled timing/heartbeat metrics
            DIAG_HEAVY: DIAG_LIGHT + detailed traces and playlist dumps

    config APP_HLS_LOG_MODE_PROD
        bool "PROD"

    config APP_HLS_LOG_MODE_RUN
        bool "RUN"

    config APP_HLS_LOG_MODE_DIAG_LIGHT
        bool "DIAG_LIGHT"

    config APP_HLS_LOG_MODE_DIAG_HEAVY
        bool "DIAG_HEAVY"

    endchoice

    config APP_HLS_LOG_THROTTLE_MS
        int "HLS log throttle min interval (ms)"
        default 5000
        range 100 60000

    config APP_HLS_LOG_SUMMARY_PERIOD_MS
        int "HLS summary period (ms)"
        default 30000
        range 1000 120000

    config APP_HLS_LOG_BURST_COUNT
        int "HLS log burst count"
        default 3
        range 1 20

    config APP_HLS_LOG_BURST_WINDOW_MS
        int "HLS log burst window (ms)"
        default 10000
        range 1000 120000

    config APP_HLS_LOG_SAMPLE_N_FAST
        int "HLS fast-loop sample 1/N"
        default 50
        range 1 1000
        help
            Sampling ratio used only in DIAG_LIGHT/DIAG_HEAVY for high-frequency logs.
            Ignored in PROD/RUN modes.

    config APP_HLS_LOG_SAMPLE_N_SLOW
        int "HLS slow-loop sample 1/N"
        default 10
        range 1 1000
        help
            Sampling ratio used only in DIAG_LIGHT/DIAG_HEAVY for medium-frequency logs.
            Ignored in PROD/RUN modes.

    config APP_HLS_PLAYER_RING_BUFFER_SIZE
        int "Ring buffer size (KB)"
        default 512 if SPIRAM
        default 64 if !SPIRAM
        range 32 1024
        help
            Size of the ring buffer for streaming data in KB.

            Recommended values:
            - With PSRAM: 512-768 KB (mitigation drop-old escalation)
            - Without PSRAM: 64-96 KB (balance RAM/stability)

            Larger buffer = more latency but more resilient to drop-old spirals.
            H1 mitigation: 512 KB gives breathing room for producer/consumer imbalance.

    config APP_HLS_PLAYER_DEC_BUFFER_SIZE
        int "Decoded buffer size (KB)"
        default 16
        range 8 32
        help
            Size of the output PCM buffer in KB.

            Default 16 KB is sufficient for most cases (48kHz stereo).
            Only increase if you experience audio glitches with high sample rates.

    config APP_HLS_PLAYER_GATHER_BUFFER_SIZE
        int "Gather buffer size (KB)"
        default 8
        range 4 16
        help
            Size of the gather buffer for assembling TS packets before decoding.

            The decoder needs a contiguous window of several KB to extract AAC frames.
            Items in the ring buffer are 188 bytes (1 TS packet), but the decoder
            needs 4-8 KB to work efficiently.

            Recommended values:
            - 4 KB: minimum, ~21 TS packets
            - 8 KB: optimal for most streams, ~42 TS packets
            - 16 KB: maximum, use only if experiencing frequent decode errors

    config APP_HLS_PLAYER_DROP_OLD_ON_FULL
        bool "Enable legacy drop-old strategy when ring buffer full"
        default n
        help
            When enabled, if the ring buffer is full, the oldest items are dropped
            until a PUSI boundary (PES start) is found, then the new data is inserted.

            Legacy behavior: maintains live-ness by discarding old TS packets.
            This can corrupt PES/AAC continuity and produce audible jumps.
            Recommended: keep disabled and rely on backpressure.

    config APP_HLS_PLAYER_STACK_DIAG
        bool "Enable stack diagnostics (HWM logging)"
        default n
        help
            Enable periodic stack High Water Mark (HWM) logging for fetch and audio tasks.

            When enabled, logs HWM every 5 seconds (debug level) to help identify
            optimal stack sizes for P0.1 stack reduction.

            Disable in production to avoid log spam.

    config APP_HLS_PLAYER_RINGBUF_DIAG
        bool "Enable ringbuffer occupancy diagnostics"
        default y
        help
            Enable periodic ringbuffer occupancy logging (used/free/percent).

            Logs occupancy at key events (write segment, drop-old, NOTIF_RESYNC/RESET)
            to diagnose producer/consumer imbalance.

            Critical for identifying if drop-old escalation is caused by:
            - Producer too aggressive (buffer always >90%)
            - Consumer stall (buffer grows despite slow producer)

    config APP_HLS_PLAYER_BACKPRESSURE
        bool "Enable fetcher backpressure"
        default y
        help
            Enable automatic backpressure on the fetcher task when ringbuffer is high.

            When enabled, the fetcher will pause downloads if ringbuffer occupancy
            exceeds the high threshold (80%), and resume when it drops below the low
            threshold (60%).

            This prevents drop-old escalation spirals by slowing down the producer
            when the consumer cannot keep up.

    config APP_HLS_PLAYER_BACKPRESSURE_HIGH
        int "Backpressure high threshold (%)"
        depends on APP_HLS_PLAYER_BACKPRESSURE
        default 80
        range 50 95
        help
            Ringbuffer occupancy threshold (%) to trigger backpressure pause.

    config APP_HLS_PLAYER_BACKPRESSURE_LOW
        int "Backpressure low threshold (%)"
        depends on APP_HLS_PLAYER_BACKPRESSURE
        default 60
        range 30 90
        help
            Ringbuffer occupancy threshold (%) to resume after backpressure pause.


    config APP_HLS_PLAYER_TS_ADMISSION_HIGH
        int "TS admission high threshold (%)"
        default 75
        range 40 95
        help
            Ringbuffer occupancy threshold (%) above which fetcher will not start
            a new TS segment download.

    config APP_HLS_PLAYER_TS_ADMISSION_LOW
        int "TS admission low threshold (%)"
        default 55
        range 20 90
        help
            Ringbuffer occupancy threshold (%) below which fetcher resumes TS
            downloads after an admission block.

    config APP_HLS_RB_GATING_ENABLE
        bool "Enable ringbuffer free-space gating for TS download"
        default y
        help
            When enabled, the fetcher waits for enough ringbuffer free-space
            before each HTTP read chunk. This avoids long blocking waits inside
            xRingbufferSend() and naturally applies TCP/TLS backpressure.

    config APP_HLS_RB_READ_CHUNK_BYTES
        int "TS read chunk size (bytes)"
        depends on APP_HLS_RB_GATING_ENABLE
        default 3760
        range 188 16384
        help
            HTTP read chunk size used by gating mode.
            A multiple of 188 bytes is recommended to reduce carry churn.

    config APP_HLS_RB_MIN_FREE_BEFORE_READ_BYTES
        int "Min ringbuffer free-space before HTTP read (bytes)"
        depends on APP_HLS_RB_GATING_ENABLE
        default 11280
        range 188 524288
        help
            Minimum free-space required before calling esp_http_client_read().
            Recommended >= 2-3x read chunk size.

    config APP_HLS_RB_START_TS_MIN_FREE_BYTES
        int "Min ringbuffer free-space to start a TS segment (bytes)"
        depends on APP_HLS_RB_GATING_ENABLE
        default 65536
        range 188 1048576
        help
            Admission block threshold in bytes.

    config APP_HLS_RB_RESUME_TS_MIN_FREE_BYTES
        int "Min ringbuffer free-space to resume TS segment start (bytes)"
        depends on APP_HLS_RB_GATING_ENABLE
        default 81920
        range 188 1048576
        help
            Admission resume threshold in bytes (hysteresis).
            At runtime, resume is clamped to ringbuffer capacity and forced
            to be >= start threshold.

    config APP_HLS_RB_GATING_POLL_MS
        int "Ringbuffer gating poll interval (ms)"
        depends on APP_HLS_RB_GATING_ENABLE
        default 20
        range 1 200
        help
            Sleep interval while waiting for ringbuffer free-space.

    config APP_HLS_RB_SEND_MAX_WAIT_MS
        int "Warn threshold for non-blocking ringbuffer send wait (ms)"
        depends on APP_HLS_RB_GATING_ENABLE
        default 200
        range 1 5000
        help
            Warning threshold for cumulative wait in xRingbufferSend(..., 0)
            retry loops while gating mode is enabled.
            Exceeding this limit emits a stall warning but does not abort
            the segment transfer.

    config APP_HLS_LIVE_CATCHUP_ENABLE
        bool "Enable live catch-up mode"
        default y
        help
            Enable STEADY/CATCHUP state machine to reduce repeated live-window drops.

    config APP_HLS_CATCHUP_ENTER_CONSECUTIVE
        int "Catch-up enter consecutive detections"
        depends on APP_HLS_LIVE_CATCHUP_ENABLE
        default 2
        range 1 10

    config APP_HLS_CATCHUP_EXIT_CONSECUTIVE
        int "Catch-up exit consecutive confirmations"
        depends on APP_HLS_LIVE_CATCHUP_ENABLE
        default 2
        range 1 10

    config APP_HLS_LIVE_EDGE_BACKOFF_MIN
        int "Live-edge backoff min (segments)"
        depends on APP_HLS_LIVE_CATCHUP_ENABLE
        default 1
        range 0 10

    config APP_HLS_LIVE_EDGE_BACKOFF_MAX
        int "Live-edge backoff max (segments)"
        depends on APP_HLS_LIVE_CATCHUP_ENABLE
        default 3
        range 1 15

    config APP_HLS_CATCHUP_SOFT_GAP
        int "Soft catch-up gap threshold (segments)"
        depends on APP_HLS_LIVE_CATCHUP_ENABLE
        default 2
        range 1 20

    config APP_HLS_CATCHUP_HARD_GAP
        int "Hard catch-up gap threshold (segments)"
        depends on APP_HLS_LIVE_CATCHUP_ENABLE
        default 4
        range 1 40

    config APP_HLS_CATCHUP_RESYNC_COOLDOWN_MS
        int "Hard resync cooldown (ms)"
        depends on APP_HLS_LIVE_CATCHUP_ENABLE
        default 8000
        range 0 120000

    config APP_HLS_SEG_PER_CYCLE_STEADY_MAX
        int "Segments per cycle max in steady mode"
        depends on APP_HLS_LIVE_CATCHUP_ENABLE
        default 2
        range 1 8

    config APP_HLS_SEG_PER_CYCLE_CATCHUP_MAX
        int "Segments per cycle max in catch-up mode"
        depends on APP_HLS_LIVE_CATCHUP_ENABLE
        default 3
        range 1 8


endmenu
```

## examples/hls_player_test/main/Kconfig.projbuild
```kconfig
menu "HLS Test Configuration"

    choice HLS_TEST_MODE
        prompt "Test mode"
        default HLS_TEST_SIMPLE_RUN
        help
            Select which test to run.

        config HLS_TEST_SIMPLE_RUN
            bool "Simple run (60s)"
        config HLS_TEST_START_STOP_CYCLES
            bool "Start/Stop cycles (3x 30s)"
        config HLS_TEST_LONG_RUN
            bool "Long run (configurable duration)"
    endchoice

    config HLS_TEST_LONG_RUN_DURATION_S
        int "Long run duration (seconds)"
        depends on HLS_TEST_LONG_RUN
        default 600
        range 60 7200
        help
            Duration in seconds for long-run test.
            Recommended: 600s (10 min) for stack HWM baseline, 3600s (1h) for stability.

endmenu
```

## examples/hls_player_test/sdkconfig.defaults
```kconfig
# Wi-Fi Configuration (example defaults)
CONFIG_EXAMPLE_WIFI_SSID="YourSSID"
CONFIG_EXAMPLE_WIFI_PASSWORD="YourPassword"

# Enable PSRAM for better performance
CONFIG_SPIRAM=y
CONFIG_SPIRAM_MODE_QUAD=y
CONFIG_SPIRAM_TYPE_AUTO=y
CONFIG_SPIRAM_SIZE=-1

# HLS Player defaults
CONFIG_APP_HLS_PLAYER_RING_BUFFER_SIZE=128
CONFIG_APP_HLS_PLAYER_DEC_BUFFER_SIZE=16
CONFIG_APP_HLS_PLAYER_GATHER_BUFFER_SIZE=8
CONFIG_APP_HLS_PLAYER_DROP_OLD_ON_FULL=y

# Enable stack diagnostics for P0.1
CONFIG_APP_HLS_PLAYER_STACK_DIAG=n

# Logging
CONFIG_LOG_DEFAULT_LEVEL_INFO=y
```

## examples/iobewi_apps_scan_tof/basic_app/sdkconfig.defaults
```kconfig
# ToF Scan Application Basic App - Default Configuration

# ESP-IDF system
CONFIG_ESP_SYSTEM_EVENT_TASK_STACK_SIZE=4096

# Log level
CONFIG_LOG_DEFAULT_LEVEL_INFO=y

# FreeRTOS
CONFIG_FREERTOS_HZ=1000

# I2C configuration
CONFIG_I2C_ENABLE_DEBUG_LOG=n

# micro-ROS scan configuration
CONFIG_MICRO_ROS_SCAN_BINS=360
CONFIG_MICRO_ROS_SCAN_BUILDER_ALLOC_MALLOC=y
CONFIG_MICRO_ROS_SCAN_ALLOC_GUARD=n

# ToF configuration
CONFIG_TOF_BIN_ALLOW_DUPLICATES=n
```
